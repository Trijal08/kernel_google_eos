## google-modules/nanohub/Kconfig
```kconfig
config NANOHUB
	tristate "Nanohub"
	select IIO
	help
	  Enable support for the nanohub sensorhub driver.

	  This driver supports the android nanohub sensorhub.

	  If in doubt, say N here.

if NANOHUB

config NANOHUB_SPI
	bool "Nanohub SPI"
	default y
	help
	  Enable nanohub SPI support.

	  If in doubt, say Y here.

config NANOHUB_BL_NXP
	bool "Nanohub NXP bootloader support"
	help
	  Enable nanohub NXP bootloader support.

	  If in doubt, say N here.

config NANOHUB_BL_ST
	bool "Nanohub STMicro bootloader support"
	help
	  Enable nanohub STMicro bootloader support.

	  If in doubt, say N here.

endif # NANOHUB
```

## google-modules/soc/msm/Kconfig.ext
```kconfig
# SPDX-License-Identifier: GPL-2.0

source "$(KCONFIG_EXT_PREFIX)Kconfig.ext_modules"
```

## google-modules/soc/msm/Kconfig.ext_modules
```kconfig
# SPDX-License-Identifier: GPL-2.0

source "$(KCONFIG_EXT_MODULES_PREFIX)private/google-modules/bms/misc/Kconfig"

source "$(KCONFIG_EXT_MODULES_PREFIX)private/google-modules/nanohub/Kconfig"
```

## google-modules/sound/mcu_mic_codec/Kconfig
```kconfig
config SND_SOC_MCU_MIC_CODEC
    tristate "ASOC MCU Mic codec"
    help
    	  ASOC Codec driver to communicate with Microphone on MCU.
```

## google-modules/touch/novatek_touch/nt383x0/Kconfig
```kconfig
#
# Novatek NT383x0 touchscreen driver configuration
#
config TOUCHSCREEN_NT383x0
	bool "Novatek NT383x0"
	default y
	help
	  Say Y here if you have a Novatek NT383x0 touchscreen connected
	  to your system.

	  If unsure, say N.
```
