// SPDX-License-Identifier: GPL-2.0
// base on: monacop.dtsi

#include "sw5100.dtsi"

/ {
	model = "Qualcomm Technologies, Inc. MonacoP";
	compatible = "qcom,monacop";
	qcom,msm-id = <517 0x10000>;
};

&soc {
	qcom,rmnet-ipa {
		status = "disabled";
	};
};

&ipa_hw {
	status = "disabled";
};
