// SPDX-License-Identifier: GPL-2.0
// base on: monaco.dts

/dts-v1/;

#include "sw5100.dtsi"

/ {
	model = "Qualcomm Technologies, Inc. Monaco SoC";
	compatible = "qcom,monaco";
	qcom,board-id = <0 0>;
};
