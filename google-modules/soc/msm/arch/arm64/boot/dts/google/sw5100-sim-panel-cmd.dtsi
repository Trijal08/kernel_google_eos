// SPDX-License-Identifier: GPL-2.0

&mdss_mdp {
	/*
	 * The panel name (ex: dsi_sim_cmd_display) must match
	 * the 3rd argument to PANEL_CREATE_ENTRY() in xbl (boot_images)
	 * QcomPkg/SocPkg/AthertonPkg/Library/MDPPlatformLib/MDPPlatformLib.c
	 */

	dsi_sim_panel_cmd: dsi_sim_cmd_display {
		qcom,mdss-dsi-panel-name = "SIM-CMD-PANEL";
		qcom,mdss-dsi-panel-type = "dsi_cmd_mode";
		qcom,mdss-dsi-panel-physical-type = "oled";
		qcom,mdss-dsi-virtual-channel-id = <0>;
		qcom,mdss-dsi-stream = <0>;
		qcom,mdss-dsi-bpp = <24>;
		qcom,mdss-dsi-color-order = "rgb_swap_rgb";
		qcom,mdss-dsi-underflow-color = <0xff>;
		qcom,mdss-dsi-border-color = <0>;
		qcom,mdss-pan-physical-width-dimension = <30>;
		qcom,mdss-pan-physical-height-dimension = <30>;

		qcom,dsi-ctrl-num = <0>;
		qcom,dsi-phy-num = <0>;

		qcom,mdss-dsi-traffic-mode = "burst_mode";
		qcom,mdss-dsi-lane-map = "lane_map_0123";
		qcom,mdss-dsi-bllp-eof-power-mode;
		qcom,mdss-dsi-bllp-power-mode;
		qcom,mdss-dsi-lane-0-state;
		qcom,mdss-dsi-dma-trigger = "trigger_sw";
		qcom,mdss-dsi-mdp-trigger = "none";
		qcom,mdss-dsi-reset-sequence = <1 10>, <0 3>, <1 10>;
		qcom,mdss-dsi-te-pin-select = <1>;
		qcom,mdss-dsi-te-dcs-command = <1>;

		qcom,mdss-dsi-bl-pmic-control-type = "bl_ctrl_dcs";
		qcom,mdss-dsi-bl-min-level = <1>;
		qcom,mdss-dsi-bl-max-level = <256>; /* NBM 0-255, HBM 256*/
		qcom,mdss-brightness-max-level = <256>;
		qcom,mdss-brightness-default-level = <204>;
		qcom,mdss-dsi-bl-hbm-min-level = <255>;
		qcom,mdss-dsi-bl-hbm-max-level = <255>;

		qcom,dsi-bl-aod-dbv-reg = <0x61>;
		qcom,dsi-bl-inter-dbv-reg = <0x51>; /* No effect, but required by parser */
		qcom,dsi-bl-hbm-dbv-reg = <0x63>;
		qcom,dsi-bl-step-list = <0>;

		qcom,panel-ack-disabled;
		qcom,mdss-dsi-te-using-wd;

		qcom,ulps-enabled;
		qcom,dsi-select-clocks = "pll_byte_clk0", "pll_dsi_clk0";
		qcom,mdss-dsi-panel-status-check-mode = "te_signal_check";

		qcom,mdss-dsi-display-timings {
			timing@0 {
				qcom,mdss-dsi-panel-phy-timings = [
					00 0C 03 03 10 1D 03 03 03 02 02 04 0B 08];
				qcom,display-topology = <1 0 1>;
				qcom,default-topology-index = <0>;
				qcom,mdss-dsi-panel-clockrate = <257541120>;

				qcom,mdss-dsi-panel-framerate = <60>;
				qcom,mdss-dsi-panel-width = <384>;
				qcom,mdss-dsi-panel-height = <384>;
				qcom,mdss-dsi-h-front-porch = <40>;
				qcom,mdss-dsi-h-back-porch = <8>;
				qcom,mdss-dsi-h-pulse-width = <0>;
				qcom,mdss-dsi-h-sync-skew = <0>;
				qcom,mdss-dsi-v-front-porch = <8>;
				qcom,mdss-dsi-v-back-porch = <22>;
				qcom,mdss-dsi-v-pulse-width = <0>;
				qcom,mdss-dsi-h-left-border = <0>;
				qcom,mdss-dsi-h-right-border = <0>;
				qcom,mdss-dsi-v-top-border = <0>;
				qcom,mdss-dsi-v-bottom-border = <0>;
			};
		};
	};
};


