// SPDX-License-Identifier: GPL-2.0-only
// Google SDHC3 device tree source

#include <dt-bindings/clock/qcom,gcc-monaco.h>
#include <dt-bindings/interconnect/qcom,monaco.h>
#include <dt-bindings/interrupt-controller/irq.h>
#include <dt-bindings/interrupt-controller/arm-gic.h>

&soc {
	sdhc_3: sdhci@4784000 {
		compatible = "qcom,sdhci-msm-v5";
		reg = <0x04784000 0x1000>;
		reg-names = "hc_mem";
		interrupts = <GIC_SPI 350 IRQ_TYPE_LEVEL_HIGH>,
			     <GIC_SPI 353 IRQ_TYPE_LEVEL_HIGH>;
		interrupt-names = "hc_irq", "pwr_irq";
		clocks = <&gcc GCC_SDCC2_APPS_CLK>, <&gcc GCC_SDCC2_AHB_CLK>;
		clock-names = "core", "iface";
		interconnects = <&system_noc MASTER_SDCC_2 &bimc SLAVE_EBI_CH0>,
				<&bimc MASTER_AMPSS_M0 &config_noc SLAVE_SDCC_2>;
		interconnect-names = "sdhc-ddr","cpu-sdhc";
		qcom,msm-bus,name = "sdhc3";
		qcom,msm-bus,num-cases = <8>;
		qcom,msm-bus,num-paths = <2>;
		qcom,msm-bus,vectors-KBps =
			/* No Vote */
			<0 0>, <0 0>,
			/* 400 KB/s*/
			<1046 3200>, <1600 1600>,
			/* 25 MB/s */
			<65360 250000>, <100000 133320>,
			/* 50 MB/s */
			<130718 250000>, <133320 133320>,
			/* 100 MB/s */
			<261438 250000>, <150000 133320>,
			/* 200 MB/s */
			<261438 800000>, <300000 300000>,
			/* Max. bandwidth */
			<1338562 4096000>, <1338562 4096000>;
		qcom,bus-bw-vectors-bps = <0 400000 25000000 50000000
				100000000 200000000 4294967295>;
		/* DLL HSR settings. Refer go/hsr - <Target> DLL settings */
		qcom,dll-hsr-list = <0x0007642c 0x0 0x0 0x00010800 0x80040868>;
		bus-width = <4>;
		iommus = <&apps_smmu 0xA0 0x0>;
		qcom,iommu-dma = "bypass";
		qcom,devfreq,freq-table = <400000 20000000 25000000 50000000 100000000>;
		status = "disabled";
	};
};
