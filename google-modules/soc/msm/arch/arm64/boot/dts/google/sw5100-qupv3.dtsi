// SPDX-License-Identifier: GPL-2.0

#include <dt-bindings/clock/qcom,gcc-monaco.h>
#include <dt-bindings/interconnect/qcom,monaco.h>

&qupv3_0 {
	qupv3_se2_4uart: qcom,qup_uart@4a88000 {
		compatible = "qcom,msm-geni-serial-hs";
		reg = <0x4a88000 0x4000>;
		reg-names = "se_phys";
		interrupts-extended = <&intc GIC_SPI 329 IRQ_TYPE_LEVEL_HIGH>,
			<&tlmm 3 IRQ_TYPE_LEVEL_HIGH>; /* uart rx */
		clock-names = "se-clk";
		clocks = <&gcc GCC_QUPV3_WRAP0_S2_CLK>;
		interconnect-names = "qup-core", "qup-config", "qup-memory";
		interconnects =
			<&clk_virt MASTER_QUP_CORE_0 &clk_virt SLAVE_QUP_CORE_0>,
			<&bimc MASTER_AMPSS_M0 &config_noc SLAVE_QUP_0>,
			<&system_noc MASTER_QUP_0 &bimc  SLAVE_EBI_CH0>;
		pinctrl-names = "default", "active", "sleep", "shutdown";
		pinctrl-0 = <&qupv3_se2_4uart_default_cts>,
			<&qupv3_se2_4uart_default_rts>, <&qupv3_se2_4uart_default_tx>,
			<&qupv3_se2_4uart_default_rx>;
		pinctrl-1 = <&qupv3_se2_4uart_cts>, <&qupv3_se2_4uart_rts>,
			<&qupv3_se2_4uart_tx>, <&qupv3_se2_4uart_rx>;
		pinctrl-2 = <&qupv3_se2_4uart_default_cts>,
			<&qupv3_se2_4uart_default_rts>, <&qupv3_se2_4uart_default_tx>,
			<&qupv3_se2_4uart_default_rx>;
		pinctrl-3 = <&qupv3_se2_4uart_default_cts>,
			<&qupv3_se2_4uart_default_rts>, <&qupv3_se2_4uart_default_tx>,
			<&qupv3_se2_4uart_default_rx>;
		qcom,wakeup-byte = <0xFD>;
		status = "disabled";
	};

	qupv3_se7_2uart_a: qcom,qup_uart_a@4a9c000 {
		compatible = "qcom,msm-geni-serial-hs";
		reg = <0x4a9c000 0x4000>;
		reg-names = "se_phys";
		interrupts = <GIC_SPI 334 IRQ_TYPE_LEVEL_HIGH>;
		clock-names = "se-clk";
		clocks = <&gcc GCC_QUPV3_WRAP0_S7_CLK>;
		interconnect-names = "qup-core", "qup-config", "qup-memory";
		interconnects =
			<&clk_virt MASTER_QUP_CORE_0 &clk_virt SLAVE_QUP_CORE_0>,
			<&bimc MASTER_AMPSS_M0 &config_noc SLAVE_QUP_0>,
			<&system_noc MASTER_QUP_0 &bimc SLAVE_EBI_CH0>;
		pinctrl-names = "active", "sleep";
		pinctrl-0 = <&qupv3_se7_2uart_active_L2_a
			&qupv3_se7_2uart_active_L3_a>;
		pinctrl-1 = <&qupv3_se7_2uart_active_L2_a
			&qupv3_se7_2uart_active_L3_a>;
		status = "disabled";
	};

	qupv3_se7_2uart_b: qcom,qup_uart_b@4a9c000 {
		compatible = "qcom,msm-geni-serial-hs";
		reg = <0x4a9c000 0x4000>;
		reg-names = "se_phys";
		interrupts = <GIC_SPI 334 IRQ_TYPE_LEVEL_HIGH>;
		clock-names = "se-clk";
		clocks = <&gcc GCC_QUPV3_WRAP0_S7_CLK>;
		interconnect-names = "qup-core", "qup-config", "qup-memory";
		interconnects =
			<&clk_virt MASTER_QUP_CORE_0 &clk_virt SLAVE_QUP_CORE_0>,
			<&bimc MASTER_AMPSS_M0 &config_noc SLAVE_QUP_0>,
			<&system_noc MASTER_QUP_0 &bimc SLAVE_EBI_CH0>;
		pinctrl-names = "active", "sleep";
		pinctrl-0 = <&qupv3_se7_2uart_active_L2_b
			&qupv3_se7_2uart_active_L3_b>;
		pinctrl-1 = <&qupv3_se7_2uart_active_L2_b
			&qupv3_se7_2uart_active_L3_b>;
		status = "disabled";
	};
};
