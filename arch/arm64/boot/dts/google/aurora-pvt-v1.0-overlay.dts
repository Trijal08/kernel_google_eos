// SPDX-License-Identifier: GPL-2.0

/dts-v1/;
/plugin/;

#include "eos-evt-v2.0.dtsi"

/ {
	model = "Google Aurora PVT 1.0";
	qcom,board-id = <0x010022 0x1>;
	board_id = <0x020505>;
	board_rev = <0x010000>;
};
